/*
 * Copyright (C) 2015 Brice DAVIER
 *
 * This program is free software; you can redistribute it and/or modify
 * it under the terms of the GNU General Public License version 2 as
 * published by the Free Software Foundation.
 * 
 * Enable eQEP0 on the Beaglebone Black - incompatible with BB White because
 * most of the eQEP0 pins on Beaglebone white are not broken out.
 */

#include "am335x-ehrpwm2.dtsi"

&ocp {
	/* eHRPWM2A */
	P8_19_pinmux {
		mode = "pwm";
	};

	/* eHRPWM2B */
	P8_13_pinmux {
		mode = "pwm";
	};
};

